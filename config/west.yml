## config/west.yml
```yaml
manifest:
  remotes:
    - name: zmkfirmware
      url-base: https://github.com/zmkfirmware
      # Additional modules containing boards/shields/custom code can be listed here as well.
      # See:
      # - https://zmk.dev/docs/features/modules
      # - https://docs.zephyrproject.org/3.5.0/develop/west/manifest.html#projects
    #MS-Battry - name: caksoylar # Add battery LED.
    #MS-Battry   url-base: https://github.com/caksoylar
  projects:
    - name: eyelash_corne
      url: https://github.com/a741725193/zmk-new_corne
      revision: main
    - name: zmk
      remote: zmkfirmware
      revision: v0.3.0
      import: app/west.yml
    #MS-Battry - name: zmk-rgbled-widget
    #MS-Battry   remote: caksoylar
    #MS-Battry   revision: main
  self:
    path: config
```
